## Kconfig
```kconfig
# Copyright (c) 2024 Arthur Eichelberger
# SPDX-License-Identifier: Apache-2.0

rsource "drivers/Kconfig"

config USB_DEVICE_VID
	hex "USB Vendor ID"
	default 0x2FE3
	help
	  USB device vendor ID. MUST be configured by vendor.

config USB_DEVICE_PID
	hex "USB Product ID"
	default 0x0100
	help
	  USB device product ID. MUST be configured by vendor.

config USB_DEVICE_MANUFACTURER
	string "USB manufacturer name"
	default "zflight"
	help
	  USB device Manufacturer string. MUST be configured by vendor.

config USB_DEVICE_PRODUCT
	string "USB product name"
	default "zflight"
	help
	  USB device Product string. MUST be configured by vendor.
```

## boards/speedybee/f7v3/Kconfig.defconfig
```kconfig
# SpeedyBee F7V3 board

# Copyright 2024 Arthur Eichelberger
# SPDX-License-Identifier: Apache-2.0

if BOARD_SPEEDYBEE_F7V3

config FC_HAS_DSHOT_BIDIR
    bool
    default y
    depends on HAS_DSHOT_BIDIR
    depends on APP_NUM_MOTORS <= 4

config FC_DSHOT_DMA_BURST
    bool
    default y
    depends on !DSHOT_BIDIR
    imply DSHOT_STM32_DMA_BURST

endif # BOARD_SPEEDYBEE_F7V3
```

## boards/speedybee/f7v3/Kconfig.speedybee_f7v3
```kconfig
# Copyright 2024 Arthur Eichelberger
# SPDX-License-Identifier: Apache-2.0

config BOARD_SPEEDYBEE_F7V3
	select SOC_STM32F722XX
```

## boards/speedybee/f7v3/board.yml
```yaml
board:
  name: speedybee_f7v3
  vendor: speedybee
  socs:
    - name: stm32f722Xe
```

## boards/speedybee/f7v3/speedybee_f7v3_defconfig
```kconfig
#
# Copyright 2024 Arthur Eichelberger
#
# SPDX-License-Identifier: Apache-2.0
#

# Enable MPU
CONFIG_ARM_MPU=y

# Enable HW stack protection
CONFIG_HW_STACK_PROTECTION=y

# Enable cache management
CONFIG_DCACHE=y
CONFIG_ICACHE=y
CONFIG_CACHE_MANAGEMENT=y
CONFIG_NOCACHE_MEMORY=y

# Enable clocks
CONFIG_CLOCK_CONTROL=y

# Enable pinctrl
CONFIG_PINCTRL=y

# Enable async UART
CONFIG_UART_ASYNC_API=y

# Enable USB terminal
CONFIG_SHELL_ASYNC_API=n
CONFIG_SHELL_PROMPT_UART="speedybee_f7v3:~$ "
CONFIG_USB_DEVICE_STACK=y
CONFIG_USB_DEVICE_PRODUCT="SpeedyBee F7V3"
CONFIG_USB_DEVICE_PID=0x0004
CONFIG_USB_CDC_ACM=y
CONFIG_UART_LINE_CTRL=y
CONFIG_USB_CDC_ACM_LOG_LEVEL_OFF=y
```

## drivers/Kconfig
```kconfig
# Copyright (c) 2024 Arthur Eichelberger
# SPDX-License-Identifier: Apache-2.0

menu "Drivers"
rsource "esc/Kconfig"
rsource "rc_link/Kconfig"
endmenu
```

## drivers/esc/dshot/Kconfig
```kconfig
# Copyright (c) 2024 Arthur Eichelberger
# SPDX-License-Identifier: Apache-2.0

menuconfig DSHOT
	bool "DShot ESC drivers"
	help
	  This option enables the DShot ESC drivers.

if DSHOT

config DSHOT_INIT_PRIORITY
	int "DShot ESC device drivers init priority"
	default KERNEL_INIT_PRIORITY_DEVICE
	help
	  DShot ESC device drivers init priority.

module = DSHOT
module-str = dshot
source "subsys/logging/Kconfig.template.log_config"

config DSHOT_SHELL
	bool "DShot shell"
	depends on SHELL
	help
	  Enable the DShot related shell commands.

config DSHOT_BIDIR
    bool "Bidirectional DShot ESC"
    depends on HAS_DSHOT_BIDIR
	help
	  This option extends the DShot driver API with the ability
	  to receive telemetry from the ESC on the signal line.

config DSHOT_EDT
    bool "Extended Bidirectional DShot Telemetry"
    depends on DSHOT_BIDIR
	help
	  This option enables extended DShot Bidirectional telemetry.
	  Without this option select, only erpm is available.

rsource "Kconfig.stm32"

endif # DSHOT
```

## drivers/esc/dshot/Kconfig.stm32
```kconfig
# Copyright (c) 2024 Arthur Eichelberger
# SPDX-License-Identifier: Apache-2.0

config DSHOT_STM32
	bool "STM32 MCU DShot driver"
	default y
	depends on DT_HAS_ST_STM32_DSHOT_ENABLED
	select HAS_DSHOT_BIDIR
	select USE_STM32_LL_TIM
	select DMA
	help
	  This option enables the DShot ESC driver for STM32 family of
	  processors. Say y if you wish to use DShot port on STM32
	  MCU.

if DSHOT_STM32
	config DSHOT_STM32_DMA_BURST
		bool "Use STM32 DMA Burst"
		depends on !DSHOT_BIDIR
		help
		  This option enables DMA burst transactions, which reduces the
		  DMA stream usage but cannot be used with bidirection DShot.
endif # DSHOT_STM32
```

## drivers/rc_link/Kconfig
```kconfig
# Copyright (c) 2024 Arthur Eichelberger
# SPDX-License-Identifier: Apache-2.0

menuconfig RC_LINK
	bool "Radio Controller Link drivers"
	select EXPERIMENTAL
	help
	  Enable RC Link drivers and configuration.

if RC_LINK

config RC_LINK_HAS_DOWNLINK_STATUS
	bool
	help
	  This is an option to be enabled by indvidual RC Link drivers
	  to signal that the driver supports a downlink status

config RC_LINK_HAS_TELEMETRY
	bool
	help
	  This is an option to be enabled by indvidual RC Link drivers
	  to signal that the driver supports telemetry

config RC_LINK_STATUS_HAS_LINK_QUALITY
	bool
	help
	  This is an option to be enabled by indvidual RC Link drivers
	  to signal that the driver supports link quality status

config RC_LINK_STATUS_HAS_RSSI_DBM
	bool
	help
	  This is an option to be enabled by indvidual RC Link drivers
	  to signal that the driver supports RSSI in dBm link status

config RC_LINK_STATUS_HAS_SNR
	bool
	help
	  This is an option to be enabled by indvidual RC Link drivers
	  to signal that the driver supports SNR link status

config RC_LINK_STATUS_HAS_POWER
	bool
	help
	  This is an option to be enabled by indvidual RC Link drivers
	  to signal that the driver supports link power status

config RC_LINK_TELEM_HAS_VBATT
	bool
	help
	  This is an option to be enabled by indvidual RC Link drivers
	  to signal that the driver supports battery voltage telemetry

config RC_LINK_TELEM_HAS_CURRENT
	bool
	help
	  This is an option to be enabled by indvidual RC Link drivers
	  to signal that the driver supports battery current telemetry

config RC_LINK_TELEM_HAS_BATT_CAPACITY
	bool
	help
	  This is an option to be enabled by indvidual RC Link drivers
	  to signal that the driver supports battery capacity telemetry

config RC_LINK_TELEM_HAS_BATT_PERCENT
	bool
	help
	  This is an option to be enabled by indvidual RC Link drivers
	  to signal that the driver supports battery percent telemetry

module = RC_LINK
module-str = rc_link
source "subsys/logging/Kconfig.template.log_config"

config RC_LINK_INIT_PRIORITY
	int "RC Link init priority"
	default 80
	range 0 99
	help
	  RC link device initialization priority.

config RC_LINK_SHELL
	bool "RC Link shell"
	depends on SHELL
	help
	  Enable the RC_LINK related shell commands.

config RC_LINK_DOWNLINK_STATUS
	bool "RC Link data received callback"
	depends on RC_LINK_HAS_DOWNLINK_STATUS
	help
	  This option enables RC Link Downlink Status

config RC_LINK_TELEMETRY
	bool "RC Link data received callback"
	depends on RC_LINK_HAS_TELEMETRY
	help
	  This option enables RC Link Telemetry

rsource "Kconfig.crsf"

endif
```

## drivers/rc_link/Kconfig.crsf
```kconfig
# TBS Crossfire RC Link configuration

# Copyright (c) 2024 Arthur Eichelberger
# SPDX-License-Identifier: Apache-2.0

config RC_LINK_CRSF
	bool "TBS Crossfire RC Link serial driver"
	default y
	depends on DT_HAS_TBS_CRSF_ENABLED
	depends on SERIAL
	depends on UART_INTERRUPT_DRIVEN
	depends on UART_USE_RUNTIME_CONFIGURE
	depends on CRC
	select CACHE_MANAGEMENT if CPU_HAS_DCACHE
	select RC_LINK_HAS_DOWNLINK_STATUS
	select RC_LINK_HAS_TELEMETRY
	select RC_LINK_STATUS_HAS_LINK_QUALITY
	select RC_LINK_STATUS_HAS_RSSI_DBM
	select RC_LINK_STATUS_HAS_SNR
	select RC_LINK_STATUS_HAS_POWER
	select RC_LINK_TELEM_HAS_VBATT
	select RC_LINK_TELEM_HAS_CURRENT
	select RC_LINK_TELEM_HAS_BATT_CAPACITY
	select RC_LINK_TELEM_HAS_BATT_PERCENT
	imply RC_LINK_TELEMETRY
	imply RC_LINK_DOWNLINK_STATUS
	help
	  This option enables the TBS Crossfire RC Link.
	  Say y if you wish to use TBS Crossfire RC Link.

if RC_LINK_CRSF

config RC_LINK_CRSF_AUTO_DETECT_ELRS
	bool "Should the driver automatically detect Express LRS RC Link"
	default y
	help
	  Should the driver automatically detect Express LRS RC Link

endif
```

## dts/bindings/esc/dshot/dshot-controller.yaml
```yaml
# Copyright (c) 2024 Arthur Eichelberger
# SPDX-License-Identifier: Apache-2.0

# Common fields for DShot controllers

include: [esc-base.yaml]

properties:
  default-type:
    type: int
    description: Default speed to set the DShot device
    default: 300
    enum:
      - 150
      - 300
      - 600
```

## dts/bindings/esc/dshot/st,stm32-dshot.yaml
```yaml
description: STM32 DShot

compatible: "st,stm32-dshot"

include: [dshot-controller.yaml, pinctrl-device.yaml, base.yaml]

properties:
  pinctrl-0:
    required: true

  pinctrl-names:
    required: true

  dmas:
    required: true

  dma-names:
    required: true

  use-dma-burst:
    type: boolean
    description: Use DMA Burst if CONFIG_DSHOT_STM32_DMA_BURST=y

  "#esc-cells":
    const: 1
    description: |
      Number of items to expect in a DShot phandle
      - channel of the timer used for DShot

esc-cells:
  - channel

child-binding:
  description: DShot channel

  properties:
    complementary:
      type: boolean
      description: Use the complementary timer channel (ex TIM1_CH1N).
```

## dts/bindings/esc/dshot/st,stm32-esc-dshot.yaml
```yaml
description: STM32 ESC DShot

compatible: "st,stm32-esc-dshot"

include: base.yaml
```

## dts/bindings/esc/esc-base.yaml
```yaml
# Copyright (c) 2024 Arthur Eichelberger
# SPDX-License-Identifier: Apache-2.0

# Common fields for DShot controllers

properties:
  "#esc-cells":
    type: int
    required: true
    description: Number of items to expect in an ESC specifier

child-binding:
  description: DShot channel

  properties:
    channel:
      type: int
      required: true
      description: Channel identifier.
      enum:
        - 1
        - 2
        - 3
        - 4

    inverted:
      type: boolean
      description: Invert the dshot output.

    status:
      type: string
      required: true
      description: Indicates the operational status of a device.
      enum:
        - "okay"
        - "disabled"
        - "reserved"
        - "fail"
        - "fail-sss"
```

## dts/bindings/rc_link/rc_link,crsf.yaml
```yaml
# Copyright 2024 NXP
# SPDX-License-Identifier: Apache-2.0

description: Team Black Sheep (TBS) Crossfire RC Link Module

compatible: "tbs,crsf"

include:
  - uart-device.yaml

properties:
  addr:
    type: int
    description: |
      CRSF device address
    default: 0xC8
    enum: [0x10, 0x12, 0x80, 0xC0, 0xC4, 0xC8, 0xCC, 0xEA, 0xEC, 0xEE, 0xEF]

  dev_name:
    type: string
    description: |
      Device name
    default: "Unknown"

  serial_num:
    type: int
    description: |
      Device Serial Number
    default: 0

  hw_ver:
    type: int
    description: |
      CRSF Hardware Version
    default: 0

  sw_ver:
    type: int
    description: |
      CRSF Software Version
    default: 0

  field_cnt:
    type: int
    description: |
      Number of fields available to protocol
    default: 0

  param_version:
    type: int
    description: |
      CRSF parameter field version
    default: 0

  elrs:
    type: boolean
    description: |
      CRSF parameter field version
```
